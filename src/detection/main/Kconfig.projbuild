## src/detection/main/Kconfig.projbuild
```kconfig
menu "User Configuration"
config IPV4_ADDR
        string "IPv4 Address"
        default "192.168.12.1"
        help
            IP of base station running the camera server
config PORT
        int "Port"
        default 3333
        help
            Port used by the camera server
endmenu
```
